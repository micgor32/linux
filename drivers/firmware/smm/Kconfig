## drivers/firmware/smm/Kconfig
```kconfig
# SPDX-License-Identifier: GPL-2.0

if GOOGLE_FIRMWARE && GOOGLE_COREBOOT_TABLE

menuconfig SMM_DRIVER
	bool "SMM from Linux (LinuxBootSMM)"
	default n
	help
	  Enables support for System Management Mode (SMM) handling by Linux.
	  coreboot reserves region for payload-owned SMI handler, shares this
	  information with the payload using coreboot tables, and leaves SMRAM
	  closed (but unlocked). Payload (Linux) is responsible for unlocking SMRAM,
	  installing handler in dedicated region and locking SMRAM.
	  If in doubt, say N.
if SMM_DRIVER

config S3_SUPPORT_SMM
	bool "Enable payload-bootloader communication on S3 resume"
	depends on ARCH_SUSPEND_POSSIBLE && SUSPEND
	default n
	help
	  If platform supports S3 resume, enables parser for S3 communication
	  info shared in coreboot table.
endif 

endif
```
